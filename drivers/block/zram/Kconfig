## drivers/block/zram/Kconfig
```kconfig
# SPDX-License-Identifier: GPL-2.0
config ZRAM
	tristate "Compressed RAM block device support"
	depends on BLOCK && SYSFS && ZSMALLOC && CRYPTO
	depends on CRYPTO_LZO || CRYPTO_ZSTD || CRYPTO_LZ4 || CRYPTO_LZ4HC || CRYPTO_842 || CRYPTO_LZ4K || CRYPTO_LZ4K_OPLUS || CRYPTO_LZ4KD || CRYPTO_DEFLATE
	help
	  Creates virtual block devices called /dev/zramX (X = 0, 1, ...).
	  Pages written to these disks are compressed and stored in memory
	  itself. These disks allow very fast I/O and compression provides
	  good amounts of memory savings.

	  It has several use cases, for example: /tmp storage, use as swap
	  disks and maybe many more.

	  See Documentation/admin-guide/blockdev/zram.rst for more information.

choice
	prompt "Default zram compressor"
	default ZRAM_DEF_COMP_LZORLE
	depends on ZRAM

config ZRAM_DEF_COMP_LZORLE
	bool "lzo-rle"
	depends on CRYPTO_LZO

config ZRAM_DEF_COMP_ZSTD
	bool "zstd"
	depends on CRYPTO_ZSTD

config ZRAM_DEF_COMP_LZ4
	bool "lz4"
	depends on CRYPTO_LZ4

config ZRAM_DEF_COMP_LZO
	bool "lzo"
	depends on CRYPTO_LZO

config ZRAM_DEF_COMP_LZ4HC
	bool "lz4hc"
	depends on CRYPTO_LZ4HC

config ZRAM_DEF_COMP_842
	bool "842"
	depends on CRYPTO_842

config ZRAM_DEF_COMP_LZ4K
	bool "lz4k"
	depends on CRYPTO_LZ4K
	
config ZRAM_DEF_COMP_LZ4K_OPLUS
	bool "lz4k"
	depends on CRYPTO_LZ4K_OPLUS

config ZRAM_DEF_COMP_LZ4KD
	bool "lz4kd"
	depends on CRYPTO_LZ4KD

config ZRAM_DEF_COMP_DEFLATE
	bool "deflate"
	depends on CRYPTO_DEFLATE

endchoice

config ZRAM_DEF_COMP
	string
	default "lzo-rle" if ZRAM_DEF_COMP_LZORLE
	default "zstd" if ZRAM_DEF_COMP_ZSTD
	default "lz4" if ZRAM_DEF_COMP_LZ4
	default "lzo" if ZRAM_DEF_COMP_LZO
	default "lz4hc" if ZRAM_DEF_COMP_LZ4HC
	default "842" if ZRAM_DEF_COMP_842
	default "lz4k" if ZRAM_DEF_COMP_LZ4K
    default "lz4k_oplus" if ZRAM_DEF_COMP_LZ4K_OPLUS
	default "lz4kd" if ZRAM_DEF_COMP_LZ4KD
	default "deflate" if ZRAM_DEF_COMP_DEFLATE

config ZRAM_WRITEBACK
       bool "Write back incompressible or idle page to backing device"
       depends on ZRAM
       help
	 With incompressible page, there is no memory saving to keep it
	 in memory. Instead, write it out to backing device.
	 For this feature, admin should set up backing device via
	 /sys/block/zramX/backing_dev.

	 With /sys/block/zramX/{idle,writeback}, application could ask
	 idle page's writeback to the backing device to save in memory.

	 See Documentation/admin-guide/blockdev/zram.rst for more information.

config ZRAM_RECLAIM
	bool "Periodically reclaim cold pages of zram (kernel-side)"
	depends on ZRAM_WRITEBACK
	default n
	help
	 Periodically write back the pages of a zram device that have not
	 been accessed for a whole interval, so the RAM consumed by zram is
	 bounded.  This is entirely kernel-side: a delayed work item marks
	 every slot idle, then offloads the slots that stayed untouched (the
	 I/O paths clear the idle bit on access).  No userspace daemon, no
	 script and no sysfs knob is involved.

	 This needs a backing device configured before the size is set (for
	 example from the device's fstab), see ZRAM_WRITEBACK above.

config ZRAM_RECLAIM_INTERVAL_MS
	int "zram reclaim interval / idle aging window (ms)"
	depends on ZRAM_RECLAIM
	default 300000
	help
	 How often the reclaim worker runs and, at the same time, how long a
	 page must stay untouched before it counts as cold.

config ZRAM_RECLAIM_THRESHOLD_MB
	int "zram reclaim only above this zram usage (MB, 0 = always)"
	depends on ZRAM_RECLAIM
	default 0
	help
	 Only start offloading once the zram device uses at least this many
	 MB.  Zero means reclaim on every interval.

config ZRAM_RECLAIM_LIMIT_MB
	int "maximum offloaded per reclaim round (MB)"
	depends on ZRAM_RECLAIM
	default 64
	help
	 Upper bound on how much a single reclaim round may write to the
	 backing device, so one round cannot dump the whole device at once.

config ZRAM_MEMORY_TRACKING
	bool "Track zRam block status"
	depends on ZRAM && DEBUG_FS
	help
	  With this feature, admin can track the state of allocated blocks
	  of zRAM. Admin could see the information via
	  /sys/kernel/debug/zram/zramX/block_state.

	  See Documentation/admin-guide/blockdev/zram.rst for more information.
```
